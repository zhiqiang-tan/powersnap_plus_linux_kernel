## drivers/gpu/drm/bridge/sn65dsi86/Kconfig
```kconfig
config DRM_I2C_SN65DSI86
	bool "TI SN65DSI86 MIPI DSI to DP bridge"
	depends on OF
	select DRM_MIPI_DSI
	help
	  TI SN65DSI86 MIPI DSI to DP bridge driver
```

## drivers/net/ethernet/realtek/r8168/Kconfig
```kconfig
config R8168
    tristate "Realtek 8168 gigabit ethernet support"
    depends on PCI
    select FW_LOADER
    select CRC32
    select MII
    ---help---
      Say Y here if you have a Realtek 8168 PCI Gigabit Ethernet adapter.

      To compile this driver as a module, choose M here: the module
      will be called r8169.  This is recommended.
```
